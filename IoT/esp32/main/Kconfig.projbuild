## IoT/esp32/main/Kconfig.projbuild
```kconfig
menu "Project Configuration"

config WIFI_SSID
    string "Example SSID"
    default "SkyNet"
    
config WIFI_PASSWORD
    string "Example Password"
    default "Summer2303"
    
config MQTT_BROKER
	string "Example Broker"
	default "mqtt://broker.hivemq.com:1883"

config MQTT_COMMAND_TOPIC
	string "Example Command Topic"
	default "org/sdu/2024/iot/my/name/command"

config MQTT_RESPONSE_TOPIC
	string "Example Response Topic"
	default "org/sdu/2024/iot/my/name/response"

config MQTT_TIME_TOPIC
	string "Example Time Topic"
	default "org/sdu/2024/iot/my/name/time"
	
config MQTT_LOG_TOPIC
	string "Example Log Topic"
	default "org/sdu/2024/iot/my/name/log"

endmenu
```
